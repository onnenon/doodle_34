## boards/shields/doodle_34/Kconfig.defconfig
```kconfig
# Copyright (c) 2024 Stephen Onnen
# SPDX-License-Identifier: MIT

if SHIELD_DOODLE_34_LEFT

config ZMK_KEYBOARD_NAME
    default "doodle_34"

config ZMK_SPLIT_ROLE_CENTRAL
    default y
endif

if SHIELD_DOODLE_34_LEFT || SHIELD_DOODLE_34_RIGHT
config ZMK_SPLIT
    default y
endif

if SHIELD_DOODLE_34_DONGLE

# Max 16 characters in keyboard name
config ZMK_KEYBOARD_NAME
    default "doodle_34"

config ZMK_SPLIT_ROLE_CENTRAL
    default y

config ZMK_SPLIT
    default y

config ZMK_SPLIT_BLE_CENTRAL_PERIPHERALS
    default 2

# Set this to ZMK_SPLIT_BLE_CENTRAL_PERIPHERALS + your desired number of BT profiles (default is 5)
config BT_MAX_CONN
    default 7

# Set this to the same number as BT_MAX_CONN
config BT_MAX_PAIRED
    default 7

endif
```

## boards/shields/doodle_34/Kconfig.shield
```kconfig
# Copyright (c) 2024 Stephen Onnen
# SPDX-License-Identifier: MIT

config SHIELD_DOODLE_34_LEFT
    def_bool $(shields_list_contains,doodle_34_left)

config SHIELD_DOODLE_34_RIGHT
    def_bool $(shields_list_contains,doodle_34_right)

config SHIELD_DOODLE_34_DONGLE
    def_bool $(shields_list_contains,doodle_34_dongle)
```
