## config/west.yml
```yaml
manifest:
  remotes:
    - name: zmkfirmware
      url-base: https://github.com/zmkfirmware
    - name: onnenon
      url-base: https://github.com/onnenon
    - name: englmaxi
      url-base: https://github.com/englmaxi
  projects:
    - name: zmk
      remote: zmkfirmware
      revision: v0.3
      import: app/west.yml
    - name: doodle_34
      revision: main
      remote: onnenon
    - name: zmk-dongle-display
      remote: englmaxi
      revision: main

  self:
    path: config
```
